#ifdef __18F13K22
     #define DEVICEID                .634
     #define WRITE_FLASH_BLOCKSIZE   .8
     #define ERASE_FLASH_BLOCKSIZE   .64
     #define END_FLASH               0x2000
     #define END_GPR                 0x100
#endif

#ifdef __18F13K50
     #define DEVICEID                .570
     #define WRITE_FLASH_BLOCKSIZE   .8
     #define ERASE_FLASH_BLOCKSIZE   .64
     #define END_FLASH               0x2000
     #define END_GPR                 0x300
#endif

#ifdef __18F14K22
     #define DEVICEID                .633
     #define WRITE_FLASH_BLOCKSIZE   .16
     #define ERASE_FLASH_BLOCKSIZE   .64
     #define END_FLASH               0x4000
     #define END_GPR                 0x200
#endif

#ifdef __18F14K50
     #define DEVICEID                .571
     #define WRITE_FLASH_BLOCKSIZE   .16
     #define ERASE_FLASH_BLOCKSIZE   .64
     #define END_FLASH               0x4000
     #define END_GPR                 0x300
#endif

#ifdef __18F23K20
     #define DEVICEID                .263
     #define WRITE_FLASH_BLOCKSIZE   .8
     #define ERASE_FLASH_BLOCKSIZE   .64
     #define END_FLASH               0x2000
     #define END_GPR                 0x200
#endif

#ifdef __18F23K22
     #define DEVICEID                .698
     #define WRITE_FLASH_BLOCKSIZE   .64
     #define ERASE_FLASH_BLOCKSIZE   .64
     #define END_FLASH               0x2000
     #define END_GPR                 0x200
#endif

#ifdef __18F24J10
     #define CONFIG_AS_FLASH
     #define DEVICEID                .232
     #define WRITE_FLASH_BLOCKSIZE   .64
     #define ERASE_FLASH_BLOCKSIZE   .1024
     #define END_FLASH               0x4000
     #define END_GPR                 0x400
#endif

#ifdef __18F24J11
     #define CONFIG_AS_FLASH
     #define DEVICEID                .620
     #define WRITE_FLASH_BLOCKSIZE   .64
     #define ERASE_FLASH_BLOCKSIZE   .1024
     #define END_FLASH               0x4000
     #define END_GPR                 0xEC0
#endif

#ifdef __18F24J50
     #define CONFIG_AS_FLASH
     #define DEVICEID                .608
     #define WRITE_FLASH_BLOCKSIZE   .64
     #define ERASE_FLASH_BLOCKSIZE   .1024
     #define END_FLASH               0x4000
     #define END_GPR                 0xEC0
#endif

#ifdef __18F24K20
     #define DEVICEID                .261
     #define WRITE_FLASH_BLOCKSIZE   .32
     #define ERASE_FLASH_BLOCKSIZE   .64
     #define END_FLASH               0x4000
     #define END_GPR                 0x300
#endif

#ifdef __18F24K22
     #define DEVICEID                .690
     #define WRITE_FLASH_BLOCKSIZE   .64
     #define ERASE_FLASH_BLOCKSIZE   .64
     #define END_FLASH               0x4000
     #define END_GPR                 0x300
#endif

#ifdef __18F25J10
     #define CONFIG_AS_FLASH
     #define DEVICEID                .224
     #define WRITE_FLASH_BLOCKSIZE   .64
     #define ERASE_FLASH_BLOCKSIZE   .1024
     #define END_FLASH               0x8000
     #define END_GPR                 0x400
#endif

#ifdef __18F25J11
     #define CONFIG_AS_FLASH
     #define DEVICEID                .621
     #define WRITE_FLASH_BLOCKSIZE   .64
     #define ERASE_FLASH_BLOCKSIZE   .1024
     #define END_FLASH               0x8000
     #define END_GPR                 0xEC0
#endif

#ifdef __18F25J50
     #define CONFIG_AS_FLASH
     #define DEVICEID                .609
     #define WRITE_FLASH_BLOCKSIZE   .64
     #define ERASE_FLASH_BLOCKSIZE   .1024
     #define END_FLASH               0x8000
     #define END_GPR                 0xEC0
#endif

#ifdef __18F25K20
     #define DEVICEID                .259
     #define WRITE_FLASH_BLOCKSIZE   .32
     #define ERASE_FLASH_BLOCKSIZE   .64
     #define END_FLASH               0x8000
     #define END_GPR                 0x600
#endif

#ifdef __18F25K22
     #define DEVICEID                .682
     #define WRITE_FLASH_BLOCKSIZE   .64
     #define ERASE_FLASH_BLOCKSIZE   .64
     #define END_FLASH               0x8000
     #define END_GPR                 0x600
#endif

#ifdef __18F25K80
     #define DEVICEID                .780
     #define WRITE_FLASH_BLOCKSIZE   .64
     #define ERASE_FLASH_BLOCKSIZE   .64
     #define END_FLASH               0x8000
     #define END_GPR                 0xE41
#endif

#ifdef __18F26J11
     #define CONFIG_AS_FLASH
     #define DEVICEID                .622
     #define WRITE_FLASH_BLOCKSIZE   .64
     #define ERASE_FLASH_BLOCKSIZE   .1024
     #define END_FLASH               0x10000
     #define END_GPR                 0xEC0
#endif

#ifdef __18F26J13
     #define CONFIG_AS_FLASH
     #define DEVICEID                .713
     #define WRITE_FLASH_BLOCKSIZE   .64
     #define ERASE_FLASH_BLOCKSIZE   .1024
     #define END_FLASH               0x10000
     #define END_GPR                 0xEB0
#endif

#ifdef __18F26J50
     #define CONFIG_AS_FLASH
     #define DEVICEID                .610
     #define WRITE_FLASH_BLOCKSIZE   .64
     #define ERASE_FLASH_BLOCKSIZE   .1024
     #define END_FLASH               0x10000
     #define END_GPR                 0xEC0
#endif

#ifdef __18F26J53
     #define CONFIG_AS_FLASH
     #define DEVICEID                .705
     #define WRITE_FLASH_BLOCKSIZE   .64
     #define ERASE_FLASH_BLOCKSIZE   .1024
     #define END_FLASH               0x10000
     #define END_GPR                 0xEB0
#endif

#ifdef __18F26K20
     #define DEVICEID                .257
     #define WRITE_FLASH_BLOCKSIZE   .64
     #define ERASE_FLASH_BLOCKSIZE   .64
     #define END_FLASH               0x10000
     #define END_GPR                 0xF60
#endif

#ifdef __18F26K22
     #define DEVICEID                .674
     #define WRITE_FLASH_BLOCKSIZE   .64
     #define ERASE_FLASH_BLOCKSIZE   .64
     #define END_FLASH               0x10000
     #define END_GPR                 0xF38
#endif

#ifdef __18F26K80
     #define DEVICEID                .777
     #define WRITE_FLASH_BLOCKSIZE   .64
     #define ERASE_FLASH_BLOCKSIZE   .64
     #define END_FLASH               0x10000
     #define END_GPR                 0xE41
#endif

#ifdef __18F27J13
     #define CONFIG_AS_FLASH
     #define DEVICEID                .715
     #define WRITE_FLASH_BLOCKSIZE   .64
     #define ERASE_FLASH_BLOCKSIZE   .1024
     #define END_FLASH               0x20000
     #define END_GPR                 0xEB0
#endif

#ifdef __18F27J53
     #define CONFIG_AS_FLASH
     #define DEVICEID                .707
     #define WRITE_FLASH_BLOCKSIZE   .64
     #define ERASE_FLASH_BLOCKSIZE   .1024
     #define END_FLASH               0x20000
     #define END_GPR                 0xEB0
#endif

#ifdef __18F43K20
     #define DEVICEID                .262
     #define WRITE_FLASH_BLOCKSIZE   .8
     #define ERASE_FLASH_BLOCKSIZE   .64
     #define END_FLASH               0x2000
     #define END_GPR                 0x200
#endif

#ifdef __18F43K22
     #define DEVICEID                .696
     #define WRITE_FLASH_BLOCKSIZE   .64
     #define ERASE_FLASH_BLOCKSIZE   .64
     #define END_FLASH               0x2000
     #define END_GPR                 0x200
#endif

#ifdef __18F44J10
     #define CONFIG_AS_FLASH
     #define DEVICEID                .233
     #define WRITE_FLASH_BLOCKSIZE   .64
     #define ERASE_FLASH_BLOCKSIZE   .1024
     #define END_FLASH               0x4000
     #define END_GPR                 0x400
#endif

#ifdef __18F44J11
     #define CONFIG_AS_FLASH
     #define DEVICEID                .623
     #define WRITE_FLASH_BLOCKSIZE   .64
     #define ERASE_FLASH_BLOCKSIZE   .1024
     #define END_FLASH               0x4000
     #define END_GPR                 0xEC0
#endif

#ifdef __18F44J50
     #define CONFIG_AS_FLASH
     #define DEVICEID                .611
     #define WRITE_FLASH_BLOCKSIZE   .64
     #define ERASE_FLASH_BLOCKSIZE   .1024
     #define END_FLASH               0x4000
     #define END_GPR                 0xEC0
#endif

#ifdef __18F44K20
     #define DEVICEID                .260
     #define WRITE_FLASH_BLOCKSIZE   .32
     #define ERASE_FLASH_BLOCKSIZE   .64
     #define END_FLASH               0x4000
     #define END_GPR                 0x300
#endif

#ifdef __18F44K22
     #define DEVICEID                .688
     #define WRITE_FLASH_BLOCKSIZE   .64
     #define ERASE_FLASH_BLOCKSIZE   .64
     #define END_FLASH               0x4000
     #define END_GPR                 0x300
#endif

#ifdef __18F45J10
     #define CONFIG_AS_FLASH
     #define DEVICEID                .225
     #define WRITE_FLASH_BLOCKSIZE   .64
     #define ERASE_FLASH_BLOCKSIZE   .1024
     #define END_FLASH               0x8000
     #define END_GPR                 0x400
#endif

#ifdef __18F45J11
     #define CONFIG_AS_FLASH
     #define DEVICEID                .624
     #define WRITE_FLASH_BLOCKSIZE   .64
     #define ERASE_FLASH_BLOCKSIZE   .1024
     #define END_FLASH               0x8000
     #define END_GPR                 0xEC0
#endif

#ifdef __18F45J50
     #define CONFIG_AS_FLASH
     #define DEVICEID                .612
     #define WRITE_FLASH_BLOCKSIZE   .64
     #define ERASE_FLASH_BLOCKSIZE   .1024
     #define END_FLASH               0x8000
     #define END_GPR                 0xEC0
#endif

#ifdef __18F45K20
     #define DEVICEID                .258
     #define WRITE_FLASH_BLOCKSIZE   .32
     #define ERASE_FLASH_BLOCKSIZE   .64
     #define END_FLASH               0x8000
     #define END_GPR                 0x600
#endif

#ifdef __18F45K22
     #define DEVICEID                .680
     #define WRITE_FLASH_BLOCKSIZE   .64
     #define ERASE_FLASH_BLOCKSIZE   .64
     #define END_FLASH               0x8000
     #define END_GPR                 0x600
#endif

#ifdef __18F45K80
     #define DEVICEID                .779
     #define WRITE_FLASH_BLOCKSIZE   .64
     #define ERASE_FLASH_BLOCKSIZE   .64
     #define END_FLASH               0x8000
     #define END_GPR                 0xE41
#endif

#ifdef __18F46J11
     #define CONFIG_AS_FLASH
     #define DEVICEID                .625
     #define WRITE_FLASH_BLOCKSIZE   .64
     #define ERASE_FLASH_BLOCKSIZE   .1024
     #define END_FLASH               0x10000
     #define END_GPR                 0xEC0
#endif

#ifdef __18F46J13
     #define CONFIG_AS_FLASH
     #define DEVICEID                .717
     #define WRITE_FLASH_BLOCKSIZE   .64
     #define ERASE_FLASH_BLOCKSIZE   .1024
     #define END_FLASH               0x10000
     #define END_GPR                 0xEB0
#endif

#ifdef __18F46J50
     #define CONFIG_AS_FLASH
     #define DEVICEID                .613
     #define WRITE_FLASH_BLOCKSIZE   .64
     #define ERASE_FLASH_BLOCKSIZE   .1024
     #define END_FLASH               0x10000
     #define END_GPR                 0xEC0
#endif

#ifdef __18F46J53
     #define CONFIG_AS_FLASH
     #define DEVICEID                .709
     #define WRITE_FLASH_BLOCKSIZE   .64
     #define ERASE_FLASH_BLOCKSIZE   .1024
     #define END_FLASH               0x10000
     #define END_GPR                 0xEB0
#endif

#ifdef __18F46K20
     #define DEVICEID                .256
     #define WRITE_FLASH_BLOCKSIZE   .64
     #define ERASE_FLASH_BLOCKSIZE   .64
     #define END_FLASH               0x10000
     #define END_GPR                 0xF60
#endif

#ifdef __18F46K22
     #define DEVICEID                .672
     #define WRITE_FLASH_BLOCKSIZE   .64
     #define ERASE_FLASH_BLOCKSIZE   .64
     #define END_FLASH               0x10000
     #define END_GPR                 0xF38
#endif

#ifdef __18F46K80
     #define DEVICEID                .776
     #define WRITE_FLASH_BLOCKSIZE   .64
     #define ERASE_FLASH_BLOCKSIZE   .64
     #define END_FLASH               0x10000
     #define END_GPR                 0xE41
#endif

#ifdef __18F47J13
     #define CONFIG_AS_FLASH
     #define DEVICEID                .719
     #define WRITE_FLASH_BLOCKSIZE   .64
     #define ERASE_FLASH_BLOCKSIZE   .1024
     #define END_FLASH               0x20000
     #define END_GPR                 0xEB0
#endif

#ifdef __18F47J53
     #define CONFIG_AS_FLASH
     #define DEVICEID                .711
     #define WRITE_FLASH_BLOCKSIZE   .64
     #define ERASE_FLASH_BLOCKSIZE   .1024
     #define END_FLASH               0x20000
     #define END_GPR                 0xEB0
#endif

#ifdef __18F63J11
     #define CONFIG_AS_FLASH
     #define DEVICEID                .456
     #define WRITE_FLASH_BLOCKSIZE   .64
     #define ERASE_FLASH_BLOCKSIZE   .1024
     #define END_FLASH               0x2000
     #define END_GPR                 0x400
#endif

#ifdef __18F63J90
     #define CONFIG_AS_FLASH
     #define DEVICEID                .448
     #define WRITE_FLASH_BLOCKSIZE   .64
     #define ERASE_FLASH_BLOCKSIZE   .1024
     #define END_FLASH               0x2000
     #define END_GPR                 0x400
#endif

#ifdef __18F64J11
     #define CONFIG_AS_FLASH
     #define DEVICEID                .457
     #define WRITE_FLASH_BLOCKSIZE   .64
     #define ERASE_FLASH_BLOCKSIZE   .1024
     #define END_FLASH               0x4000
     #define END_GPR                 0x400
#endif

#ifdef __18F64J90
     #define CONFIG_AS_FLASH
     #define DEVICEID                .449
     #define WRITE_FLASH_BLOCKSIZE   .64
     #define ERASE_FLASH_BLOCKSIZE   .1024
     #define END_FLASH               0x4000
     #define END_GPR                 0x400
#endif

#ifdef __18F65J10
     #define CONFIG_AS_FLASH
     #define DEVICEID                .169
     #define WRITE_FLASH_BLOCKSIZE   .64
     #define ERASE_FLASH_BLOCKSIZE   .1024
     #define END_FLASH               0x8000
     #define END_GPR                 0x800
#endif

#ifdef __18F65J11
     #define CONFIG_AS_FLASH
     #define DEVICEID                .459
     #define WRITE_FLASH_BLOCKSIZE   .64
     #define ERASE_FLASH_BLOCKSIZE   .1024
     #define END_FLASH               0x8000
     #define END_GPR                 0x800
#endif

#ifdef __18F65J15
     #define CONFIG_AS_FLASH
     #define DEVICEID                .170
     #define WRITE_FLASH_BLOCKSIZE   .64
     #define ERASE_FLASH_BLOCKSIZE   .1024
     #define END_FLASH               0xC000
     #define END_GPR                 0x800
#endif

#ifdef __18F65J50
     #define CONFIG_AS_FLASH
     #define DEVICEID                .520
     #define WRITE_FLASH_BLOCKSIZE   .64
     #define ERASE_FLASH_BLOCKSIZE   .1024
     #define END_FLASH               0x8000
     #define END_GPR                 0xF40
#endif

#ifdef __18F65J90
     #define CONFIG_AS_FLASH
     #define DEVICEID                .451
     #define WRITE_FLASH_BLOCKSIZE   .64
     #define ERASE_FLASH_BLOCKSIZE   .1024
     #define END_FLASH               0x8000
     #define END_GPR                 0x800
#endif

#ifdef __18F65K22
     #define DEVICEID                .664
     #define WRITE_FLASH_BLOCKSIZE   .64
     #define ERASE_FLASH_BLOCKSIZE   .64
     #define END_FLASH               0x8000
     #define END_GPR                 0x800
#endif

#ifdef __18F65K80
     #define DEVICEID                .778
     #define WRITE_FLASH_BLOCKSIZE   .64
     #define ERASE_FLASH_BLOCKSIZE   .64
     #define END_FLASH               0x8000
     #define END_GPR                 0xE41
#endif

#ifdef __18F65K90
     #define DEVICEID                .658
     #define WRITE_FLASH_BLOCKSIZE   .64
     #define ERASE_FLASH_BLOCKSIZE   .64
     #define END_FLASH               0x8000
     #define END_GPR                 0x800
#endif

#ifdef __18F66J10
     #define CONFIG_AS_FLASH
     #define DEVICEID                .171
     #define WRITE_FLASH_BLOCKSIZE   .64
     #define ERASE_FLASH_BLOCKSIZE   .1024
     #define END_FLASH               0x10000
     #define END_GPR                 0x800
#endif

#ifdef __18F66J11
     #define CONFIG_AS_FLASH
     #define DEVICEID                .546
     #define WRITE_FLASH_BLOCKSIZE   .64
     #define ERASE_FLASH_BLOCKSIZE   .1024
     #define END_FLASH               0x10000
     #define END_GPR                 0xF40
#endif

#ifdef __18F66J15
     #define CONFIG_AS_FLASH
     #define DEVICEID                .172
     #define WRITE_FLASH_BLOCKSIZE   .64
     #define ERASE_FLASH_BLOCKSIZE   .1024
     #define END_FLASH               0x18000
     #define END_GPR                 0xF60
#endif

#ifdef __18F66J16
     #define CONFIG_AS_FLASH
     #define DEVICEID                .547
     #define WRITE_FLASH_BLOCKSIZE   .64
     #define ERASE_FLASH_BLOCKSIZE   .1024
     #define END_FLASH               0x18000
     #define END_GPR                 0xF40
#endif

#ifdef __18F66J50
     #define CONFIG_AS_FLASH
     #define DEVICEID                .522
     #define WRITE_FLASH_BLOCKSIZE   .64
     #define ERASE_FLASH_BLOCKSIZE   .1024
     #define END_FLASH               0x10000
     #define END_GPR                 0xF40
#endif

#ifdef __18F66J55
     #define CONFIG_AS_FLASH
     #define DEVICEID                .523
     #define WRITE_FLASH_BLOCKSIZE   .64
     #define ERASE_FLASH_BLOCKSIZE   .1024
     #define END_FLASH               0x18000
     #define END_GPR                 0xF40
#endif

#ifdef __18F66J60
     #define CONFIG_AS_FLASH
     #define DEVICEID                .192
     #define WRITE_FLASH_BLOCKSIZE   .64
     #define ERASE_FLASH_BLOCKSIZE   .1024
     #define END_FLASH               0x10000
     #define END_GPR                 0xE80
#endif

#ifdef __18F66J65
     #define CONFIG_AS_FLASH
     #define DEVICEID                .248
     #define WRITE_FLASH_BLOCKSIZE   .64
     #define ERASE_FLASH_BLOCKSIZE   .1024
     #define END_FLASH               0x18000
     #define END_GPR                 0xE80
#endif

#ifdef __18F66J90
     #define CONFIG_AS_FLASH
     #define DEVICEID                .640
     #define WRITE_FLASH_BLOCKSIZE   .64
     #define ERASE_FLASH_BLOCKSIZE   .1024
     #define END_FLASH               0x10000
     #define END_GPR                 0xF54
#endif

#ifdef __18F66J93
     #define CONFIG_AS_FLASH
     #define DEVICEID                .642
     #define WRITE_FLASH_BLOCKSIZE   .64
     #define ERASE_FLASH_BLOCKSIZE   .1024
     #define END_FLASH               0x10000
     #define END_GPR                 0xF54
#endif

#ifdef __18F66K22
     #define DEVICEID                .662
     #define WRITE_FLASH_BLOCKSIZE   .64
     #define ERASE_FLASH_BLOCKSIZE   .64
     #define END_FLASH               0x10000
     #define END_GPR                 0xF16
#endif

#ifdef __18F66K80
     #define DEVICEID                .775
     #define WRITE_FLASH_BLOCKSIZE   .64
     #define ERASE_FLASH_BLOCKSIZE   .64
     #define END_FLASH               0x10000
     #define END_GPR                 0xE41
#endif

#ifdef __18F66K90
     #define DEVICEID                .656
     #define WRITE_FLASH_BLOCKSIZE   .64
     #define ERASE_FLASH_BLOCKSIZE   .64
     #define END_FLASH               0x10000
     #define END_GPR                 0xEF4
#endif

#ifdef __18F67J10
     #define CONFIG_AS_FLASH
     #define DEVICEID                .173
     #define WRITE_FLASH_BLOCKSIZE   .64
     #define ERASE_FLASH_BLOCKSIZE   .1024
     #define END_FLASH               0x20000
     #define END_GPR                 0xF60
#endif

#ifdef __18F67J11
     #define CONFIG_AS_FLASH
     #define DEVICEID                .548
     #define WRITE_FLASH_BLOCKSIZE   .64
     #define ERASE_FLASH_BLOCKSIZE   .1024
     #define END_FLASH               0x20000
     #define END_GPR                 0xF40
#endif

#ifdef __18F67J50
     #define CONFIG_AS_FLASH
     #define DEVICEID                .524
     #define WRITE_FLASH_BLOCKSIZE   .64
     #define ERASE_FLASH_BLOCKSIZE   .1024
     #define END_FLASH               0x20000
     #define END_GPR                 0xF40
#endif

#ifdef __18F67J60
     #define CONFIG_AS_FLASH
     #define DEVICEID                .249
     #define WRITE_FLASH_BLOCKSIZE   .64
     #define ERASE_FLASH_BLOCKSIZE   .1024
     #define END_FLASH               0x20000
     #define END_GPR                 0xE80
#endif

#ifdef __18F67J90
     #define CONFIG_AS_FLASH
     #define DEVICEID                .641
     #define WRITE_FLASH_BLOCKSIZE   .64
     #define ERASE_FLASH_BLOCKSIZE   .1024
     #define END_FLASH               0x20000
     #define END_GPR                 0xF54
#endif

#ifdef __18F67J93
     #define CONFIG_AS_FLASH
     #define DEVICEID                .643
     #define WRITE_FLASH_BLOCKSIZE   .64
     #define ERASE_FLASH_BLOCKSIZE   .1024
     #define END_FLASH               0x20000
     #define END_GPR                 0xF54
#endif

#ifdef __18F67K22
     #define DEVICEID                .652
     #define WRITE_FLASH_BLOCKSIZE   .128
     #define ERASE_FLASH_BLOCKSIZE   .128
     #define END_FLASH               0x20000
     #define END_GPR                 0xF16
#endif

#ifdef __18F67K90
     #define DEVICEID                .648
     #define WRITE_FLASH_BLOCKSIZE   .128
     #define ERASE_FLASH_BLOCKSIZE   .128
     #define END_FLASH               0x20000
     #define END_GPR                 0xEF4
#endif

#ifdef __18F83J11
     #define CONFIG_AS_FLASH
     #define DEVICEID                .460
     #define WRITE_FLASH_BLOCKSIZE   .64
     #define ERASE_FLASH_BLOCKSIZE   .1024
     #define END_FLASH               0x2000
     #define END_GPR                 0x400
#endif

#ifdef __18F83J90
     #define CONFIG_AS_FLASH
     #define DEVICEID                .452
     #define WRITE_FLASH_BLOCKSIZE   .64
     #define ERASE_FLASH_BLOCKSIZE   .1024
     #define END_FLASH               0x2000
     #define END_GPR                 0x400
#endif

#ifdef __18F84J11
     #define CONFIG_AS_FLASH
     #define DEVICEID                .461
     #define WRITE_FLASH_BLOCKSIZE   .64
     #define ERASE_FLASH_BLOCKSIZE   .1024
     #define END_FLASH               0x4000
     #define END_GPR                 0x400
#endif

#ifdef __18F84J90
     #define CONFIG_AS_FLASH
     #define DEVICEID                .453
     #define WRITE_FLASH_BLOCKSIZE   .64
     #define ERASE_FLASH_BLOCKSIZE   .1024
     #define END_FLASH               0x4000
     #define END_GPR                 0x400
#endif

#ifdef __18F85J10
     #define CONFIG_AS_FLASH
     #define DEVICEID                .175
     #define WRITE_FLASH_BLOCKSIZE   .64
     #define ERASE_FLASH_BLOCKSIZE   .1024
     #define END_FLASH               0x8000
     #define END_GPR                 0x800
#endif

#ifdef __18F85J11
     #define CONFIG_AS_FLASH
     #define DEVICEID                .463
     #define WRITE_FLASH_BLOCKSIZE   .64
     #define ERASE_FLASH_BLOCKSIZE   .1024
     #define END_FLASH               0x8000
     #define END_GPR                 0x800
#endif

#ifdef __18F85J15
     #define CONFIG_AS_FLASH
     #define DEVICEID                .184
     #define WRITE_FLASH_BLOCKSIZE   .64
     #define ERASE_FLASH_BLOCKSIZE   .1024
     #define END_FLASH               0xC000
     #define END_GPR                 0x800
#endif

#ifdef __18F85J50
     #define CONFIG_AS_FLASH
     #define DEVICEID                .525
     #define WRITE_FLASH_BLOCKSIZE   .64
     #define ERASE_FLASH_BLOCKSIZE   .1024
     #define END_FLASH               0x8000
     #define END_GPR                 0xF40
#endif

#ifdef __18F85J90
     #define CONFIG_AS_FLASH
     #define DEVICEID                .455
     #define WRITE_FLASH_BLOCKSIZE   .64
     #define ERASE_FLASH_BLOCKSIZE   .1024
     #define END_FLASH               0x8000
     #define END_GPR                 0x800
#endif

#ifdef __18F85K22
     #define DEVICEID                .667
     #define WRITE_FLASH_BLOCKSIZE   .64
     #define ERASE_FLASH_BLOCKSIZE   .64
     #define END_FLASH               0x8000
     #define END_GPR                 0x800
#endif

#ifdef __18F85K90
     #define DEVICEID                .661
     #define WRITE_FLASH_BLOCKSIZE   .64
     #define ERASE_FLASH_BLOCKSIZE   .64
     #define END_FLASH               0x8000
     #define END_GPR                 0x800
#endif

#ifdef __18F86J10
     #define CONFIG_AS_FLASH
     #define DEVICEID                .185
     #define WRITE_FLASH_BLOCKSIZE   .64
     #define ERASE_FLASH_BLOCKSIZE   .1024
     #define END_FLASH               0x10000
     #define END_GPR                 0x800
#endif

#ifdef __18F86J11
     #define CONFIG_AS_FLASH
     #define DEVICEID                .551
     #define WRITE_FLASH_BLOCKSIZE   .64
     #define ERASE_FLASH_BLOCKSIZE   .1024
     #define END_FLASH               0x10000
     #define END_GPR                 0xF40
#endif

#ifdef __18F86J15
     #define CONFIG_AS_FLASH
     #define DEVICEID                .186
     #define WRITE_FLASH_BLOCKSIZE   .64
     #define ERASE_FLASH_BLOCKSIZE   .1024
     #define END_FLASH               0x18000
     #define END_GPR                 0xF60
#endif

#ifdef __18F86J16
     #define CONFIG_AS_FLASH
     #define DEVICEID                .552
     #define WRITE_FLASH_BLOCKSIZE   .64
     #define ERASE_FLASH_BLOCKSIZE   .1024
     #define END_FLASH               0x18000
     #define END_GPR                 0xF40
#endif

#ifdef __18F86J50
     #define CONFIG_AS_FLASH
     #define DEVICEID                .527
     #define WRITE_FLASH_BLOCKSIZE   .64
     #define ERASE_FLASH_BLOCKSIZE   .1024
     #define END_FLASH               0x10000
     #define END_GPR                 0xF40
#endif

#ifdef __18F86J55
     #define CONFIG_AS_FLASH
     #define DEVICEID                .528
     #define WRITE_FLASH_BLOCKSIZE   .64
     #define ERASE_FLASH_BLOCKSIZE   .1024
     #define END_FLASH               0x18000
     #define END_GPR                 0xF40
#endif

#ifdef __18F86J60
     #define CONFIG_AS_FLASH
     #define DEVICEID                .193
     #define WRITE_FLASH_BLOCKSIZE   .64
     #define ERASE_FLASH_BLOCKSIZE   .1024
     #define END_FLASH               0x10000
     #define END_GPR                 0xE80
#endif

#ifdef __18F86J65
     #define CONFIG_AS_FLASH
     #define DEVICEID                .250
     #define WRITE_FLASH_BLOCKSIZE   .64
     #define ERASE_FLASH_BLOCKSIZE   .1024
     #define END_FLASH               0x18000
     #define END_GPR                 0xE80
#endif

#ifdef __18F86J72
     #define CONFIG_AS_FLASH
     #define DEVICEID                .642
     #define WRITE_FLASH_BLOCKSIZE   .64
     #define ERASE_FLASH_BLOCKSIZE   .1024
     #define END_FLASH               0x10000
     #define END_GPR                 0xF54
#endif

#ifdef __18F86J90
     #define CONFIG_AS_FLASH
     #define DEVICEID                .644
     #define WRITE_FLASH_BLOCKSIZE   .64
     #define ERASE_FLASH_BLOCKSIZE   .1024
     #define END_FLASH               0x10000
     #define END_GPR                 0xF54
#endif

#ifdef __18F86J93
     #define CONFIG_AS_FLASH
     #define DEVICEID                .646
     #define WRITE_FLASH_BLOCKSIZE   .64
     #define ERASE_FLASH_BLOCKSIZE   .1024
     #define END_FLASH               0x10000
     #define END_GPR                 0xF54
#endif

#ifdef __18F86K22
     #define DEVICEID                .665
     #define WRITE_FLASH_BLOCKSIZE   .64
     #define ERASE_FLASH_BLOCKSIZE   .64
     #define END_FLASH               0x10000
     #define END_GPR                 0xF16
#endif

#ifdef __18F86K90
     #define DEVICEID                .659
     #define WRITE_FLASH_BLOCKSIZE   .64
     #define ERASE_FLASH_BLOCKSIZE   .64
     #define END_FLASH               0x10000
     #define END_GPR                 0xEF4
#endif

#ifdef __18F87J10
     #define CONFIG_AS_FLASH
     #define DEVICEID                .187
     #define WRITE_FLASH_BLOCKSIZE   .64
     #define ERASE_FLASH_BLOCKSIZE   .1024
     #define END_FLASH               0x20000
     #define END_GPR                 0xF60
#endif

#ifdef __18F87J11
     #define CONFIG_AS_FLASH
     #define DEVICEID                .553
     #define WRITE_FLASH_BLOCKSIZE   .64
     #define ERASE_FLASH_BLOCKSIZE   .1024
     #define END_FLASH               0x20000
     #define END_GPR                 0xF40
#endif

#ifdef __18F87J50
     #define CONFIG_AS_FLASH
     #define DEVICEID                .529
     #define WRITE_FLASH_BLOCKSIZE   .64
     #define ERASE_FLASH_BLOCKSIZE   .1024
     #define END_FLASH               0x20000
     #define END_GPR                 0xF40
#endif

#ifdef __18F87J60
     #define CONFIG_AS_FLASH
     #define DEVICEID                .251
     #define WRITE_FLASH_BLOCKSIZE   .64
     #define ERASE_FLASH_BLOCKSIZE   .1024
     #define END_FLASH               0x20000
     #define END_GPR                 0xE80
#endif

#ifdef __18F87J72
     #define CONFIG_AS_FLASH
     #define DEVICEID                .643
     #define WRITE_FLASH_BLOCKSIZE   .64
     #define ERASE_FLASH_BLOCKSIZE   .1024
     #define END_FLASH               0x20000
     #define END_GPR                 0xF54
#endif

#ifdef __18F87J90
     #define CONFIG_AS_FLASH
     #define DEVICEID                .645
     #define WRITE_FLASH_BLOCKSIZE   .64
     #define ERASE_FLASH_BLOCKSIZE   .1024
     #define END_FLASH               0x20000
     #define END_GPR                 0xF54
#endif

#ifdef __18F87J93
     #define CONFIG_AS_FLASH
     #define DEVICEID                .647
     #define WRITE_FLASH_BLOCKSIZE   .64
     #define ERASE_FLASH_BLOCKSIZE   .1024
     #define END_FLASH               0x20000
     #define END_GPR                 0xF54
#endif

#ifdef __18F87K22
     #define DEVICEID                .654
     #define WRITE_FLASH_BLOCKSIZE   .128
     #define ERASE_FLASH_BLOCKSIZE   .128
     #define END_FLASH               0x20000
     #define END_GPR                 0xF16
#endif

#ifdef __18F87K90
     #define DEVICEID                .650
     #define WRITE_FLASH_BLOCKSIZE   .128
     #define ERASE_FLASH_BLOCKSIZE   .128
     #define END_FLASH               0x20000
     #define END_GPR                 0xEF4
#endif

#ifdef __18F96J60
     #define CONFIG_AS_FLASH
     #define DEVICEID                .194
     #define WRITE_FLASH_BLOCKSIZE   .64
     #define ERASE_FLASH_BLOCKSIZE   .1024
     #define END_FLASH               0x10000
     #define END_GPR                 0xE80
#endif

#ifdef __18F96J65
     #define CONFIG_AS_FLASH
     #define DEVICEID                .252
     #define WRITE_FLASH_BLOCKSIZE   .64
     #define ERASE_FLASH_BLOCKSIZE   .1024
     #define END_FLASH               0x18000
     #define END_GPR                 0xE80
#endif

#ifdef __18F97J60
     #define CONFIG_AS_FLASH
     #define DEVICEID                .253
     #define WRITE_FLASH_BLOCKSIZE   .64
     #define ERASE_FLASH_BLOCKSIZE   .1024
     #define END_FLASH               0x20000
     #define END_GPR                 0xE80
#endif

#ifdef __18F242
     #define DEVICEID                .36
     #define WRITE_FLASH_BLOCKSIZE   .8
     #define ERASE_FLASH_BLOCKSIZE   .64
     #define END_FLASH               0x4000
     #define END_GPR                 0x300
#endif

#ifdef __18F248
     #define DEVICEID                .64
     #define WRITE_FLASH_BLOCKSIZE   .8
     #define ERASE_FLASH_BLOCKSIZE   .64
     #define END_FLASH               0x4000
     #define END_GPR                 0x300
#endif

#ifdef __18F252
     #define DEVICEID                .32
     #define WRITE_FLASH_BLOCKSIZE   .8
     #define ERASE_FLASH_BLOCKSIZE   .64
     #define END_FLASH               0x8000
     #define END_GPR                 0x600
#endif

#ifdef __18F258
     #define DEVICEID                .66
     #define WRITE_FLASH_BLOCKSIZE   .8
     #define ERASE_FLASH_BLOCKSIZE   .64
     #define END_FLASH               0x8000
     #define END_GPR                 0x600
#endif

#ifdef __18F442
     #define DEVICEID                .37
     #define WRITE_FLASH_BLOCKSIZE   .8
     #define ERASE_FLASH_BLOCKSIZE   .64
     #define END_FLASH               0x4000
     #define END_GPR                 0x300
#endif

#ifdef __18F448
     #define DEVICEID                .65
     #define WRITE_FLASH_BLOCKSIZE   .8
     #define ERASE_FLASH_BLOCKSIZE   .64
     #define END_FLASH               0x4000
     #define END_GPR                 0x300
#endif

#ifdef __18F452
     #define DEVICEID                .33
     #define WRITE_FLASH_BLOCKSIZE   .8
     #define ERASE_FLASH_BLOCKSIZE   .64
     #define END_FLASH               0x8000
     #define END_GPR                 0x600
#endif

#ifdef __18F458
     #define DEVICEID                .67
     #define WRITE_FLASH_BLOCKSIZE   .8
     #define ERASE_FLASH_BLOCKSIZE   .64
     #define END_FLASH               0x8000
     #define END_GPR                 0x600
#endif

#ifdef __18F1220
     #define DEVICEID                .63
     #define WRITE_FLASH_BLOCKSIZE   .8
     #define ERASE_FLASH_BLOCKSIZE   .64
     #define END_FLASH               0x1000
     #define END_GPR                 0x100
#endif

#ifdef __18F1230
     #define DEVICEID                .240
     #define WRITE_FLASH_BLOCKSIZE   .8
     #define ERASE_FLASH_BLOCKSIZE   .64
     #define END_FLASH               0x1000
     #define END_GPR                 0x100
#endif

#ifdef __18F1320
     #define DEVICEID                .62
     #define WRITE_FLASH_BLOCKSIZE   .8
     #define ERASE_FLASH_BLOCKSIZE   .64
     #define END_FLASH               0x2000
     #define END_GPR                 0x100
#endif

#ifdef __18F1330
     #define DEVICEID                .241
     #define WRITE_FLASH_BLOCKSIZE   .8
     #define ERASE_FLASH_BLOCKSIZE   .64
     #define END_FLASH               0x2000
     #define END_GPR                 0x100
#endif

#ifdef __18F2220
     #define DEVICEID                .44
     #define WRITE_FLASH_BLOCKSIZE   .8
     #define ERASE_FLASH_BLOCKSIZE   .64
     #define END_FLASH               0x1000
     #define END_GPR                 0x200
#endif

#ifdef __18F2221
     #define DEVICEID                .267
     #define WRITE_FLASH_BLOCKSIZE   .8
     #define ERASE_FLASH_BLOCKSIZE   .64
     #define END_FLASH               0x1000
     #define END_GPR                 0x200
#endif

#ifdef __18F2320
     #define DEVICEID                .40
     #define WRITE_FLASH_BLOCKSIZE   .8
     #define ERASE_FLASH_BLOCKSIZE   .64
     #define END_FLASH               0x2000
     #define END_GPR                 0x200
#endif

#ifdef __18F2321
     #define DEVICEID                .265
     #define WRITE_FLASH_BLOCKSIZE   .8
     #define ERASE_FLASH_BLOCKSIZE   .64
     #define END_FLASH               0x2000
     #define END_GPR                 0x200
#endif

#ifdef __18F2331
     #define DEVICEID                .71
     #define WRITE_FLASH_BLOCKSIZE   .8
     #define ERASE_FLASH_BLOCKSIZE   .64
     #define END_FLASH               0x2000
     #define END_GPR                 0x300
#endif

#ifdef __18F2410
     #define DEVICEID                .139
     #define WRITE_FLASH_BLOCKSIZE   .32
     #define ERASE_FLASH_BLOCKSIZE   .64
     #define END_FLASH               0x4000
     #define END_GPR                 0x300
#endif

#ifdef __18F2420
     #define DEVICEID                .138
     #define WRITE_FLASH_BLOCKSIZE   .32
     #define ERASE_FLASH_BLOCKSIZE   .64
     #define END_FLASH               0x4000
     #define END_GPR                 0x300
#endif

#ifdef __18F2423
     #define DEVICEID                .277
     #define WRITE_FLASH_BLOCKSIZE   .32
     #define ERASE_FLASH_BLOCKSIZE   .64
     #define END_FLASH               0x4000
     #define END_GPR                 0x300
#endif

#ifdef __18F2431
     #define DEVICEID                .70
     #define WRITE_FLASH_BLOCKSIZE   .8
     #define ERASE_FLASH_BLOCKSIZE   .64
     #define END_FLASH               0x4000
     #define END_GPR                 0x300
#endif

#ifdef __18F2439
     #define DEVICEID                .36
     #define WRITE_FLASH_BLOCKSIZE   .8
     #define ERASE_FLASH_BLOCKSIZE   .64
     #define END_FLASH               0x3000
     #define END_GPR                 0x280
#endif

#ifdef __18F2450
     #define DEVICEID                .289
     #define WRITE_FLASH_BLOCKSIZE   .16
     #define ERASE_FLASH_BLOCKSIZE   .64
     #define END_FLASH               0x4000
     #define END_GPR                 0x500
#endif

#ifdef __18F2455
     #define DEVICEID                .147
     #define WRITE_FLASH_BLOCKSIZE   .32
     #define ERASE_FLASH_BLOCKSIZE   .64
     #define END_FLASH               0x6000
     #define END_GPR                 0x800
#endif

#ifdef __18F2458
     #define DEVICEID                .339
     #define WRITE_FLASH_BLOCKSIZE   .32
     #define ERASE_FLASH_BLOCKSIZE   .64
     #define END_FLASH               0x6000
     #define END_GPR                 0x800
#endif

#ifdef __18F2480
     #define DEVICEID                .215
     #define WRITE_FLASH_BLOCKSIZE   .32
     #define ERASE_FLASH_BLOCKSIZE   .64
     #define END_FLASH               0x4000
     #define END_GPR                 0x300
#endif

#ifdef __18F2510
     #define DEVICEID                .137
     #define WRITE_FLASH_BLOCKSIZE   .32
     #define ERASE_FLASH_BLOCKSIZE   .64
     #define END_FLASH               0x8000
     #define END_GPR                 0x600
#endif

#ifdef __18F2515
     #define DEVICEID                .103
     #define WRITE_FLASH_BLOCKSIZE   .64
     #define ERASE_FLASH_BLOCKSIZE   .64
     #define END_FLASH               0xC000
     #define END_GPR                 0xF80
#endif

#ifdef __18F2520
     #define DEVICEID                .136
     #define WRITE_FLASH_BLOCKSIZE   .32
     #define ERASE_FLASH_BLOCKSIZE   .64
     #define END_FLASH               0x8000
     #define END_GPR                 0x600
#endif

#ifdef __18F2523
     #define DEVICEID                .273
     #define WRITE_FLASH_BLOCKSIZE   .32
     #define ERASE_FLASH_BLOCKSIZE   .64
     #define END_FLASH               0x8000
     #define END_GPR                 0x600
#endif

#ifdef __18F2525
     #define DEVICEID                .102
     #define WRITE_FLASH_BLOCKSIZE   .64
     #define ERASE_FLASH_BLOCKSIZE   .64
     #define END_FLASH               0xC000
     #define END_GPR                 0xF80
#endif

#ifdef __18F2539
     #define DEVICEID                .32
     #define WRITE_FLASH_BLOCKSIZE   .8
     #define ERASE_FLASH_BLOCKSIZE   .64
     #define END_FLASH               0x6000
     #define END_GPR                 0x580
#endif

#ifdef __18F2550
     #define DEVICEID                .146
     #define WRITE_FLASH_BLOCKSIZE   .32
     #define ERASE_FLASH_BLOCKSIZE   .64
     #define END_FLASH               0x8000
     #define END_GPR                 0x800
#endif

#ifdef __18F2553
     #define DEVICEID                .338
     #define WRITE_FLASH_BLOCKSIZE   .32
     #define ERASE_FLASH_BLOCKSIZE   .64
     #define END_FLASH               0x8000
     #define END_GPR                 0x800
#endif

#ifdef __18F2580
     #define DEVICEID                .214
     #define WRITE_FLASH_BLOCKSIZE   .32
     #define ERASE_FLASH_BLOCKSIZE   .64
     #define END_FLASH               0x8000
     #define END_GPR                 0x600
#endif

#ifdef __18F2585
     #define DEVICEID                .119
     #define WRITE_FLASH_BLOCKSIZE   .64
     #define ERASE_FLASH_BLOCKSIZE   .64
     #define END_FLASH               0xC000
     #define END_GPR                 0xD00
#endif

#ifdef __18F2610
     #define DEVICEID                .101
     #define WRITE_FLASH_BLOCKSIZE   .64
     #define ERASE_FLASH_BLOCKSIZE   .64
     #define END_FLASH               0x10000
     #define END_GPR                 0xF80
#endif

#ifdef __18F2620
     #define DEVICEID                .100
     #define WRITE_FLASH_BLOCKSIZE   .64
     #define ERASE_FLASH_BLOCKSIZE   .64
     #define END_FLASH               0x10000
     #define END_GPR                 0xF80
#endif

#ifdef __18F2680
     #define DEVICEID                .118
     #define WRITE_FLASH_BLOCKSIZE   .64
     #define ERASE_FLASH_BLOCKSIZE   .64
     #define END_FLASH               0x10000
     #define END_GPR                 0xD00
#endif

#ifdef __18F2682
     #define DEVICEID                .312
     #define WRITE_FLASH_BLOCKSIZE   .64
     #define ERASE_FLASH_BLOCKSIZE   .64
     #define END_FLASH               0x14000
     #define END_GPR                 0xD00
#endif

#ifdef __18F2685
     #define DEVICEID                .313
     #define WRITE_FLASH_BLOCKSIZE   .64
     #define ERASE_FLASH_BLOCKSIZE   .64
     #define END_FLASH               0x18000
     #define END_GPR                 0xD00
#endif

#ifdef __18F4220
     #define DEVICEID                .45
     #define WRITE_FLASH_BLOCKSIZE   .8
     #define ERASE_FLASH_BLOCKSIZE   .64
     #define END_FLASH               0x1000
     #define END_GPR                 0x200
#endif

#ifdef __18F4221
     #define DEVICEID                .266
     #define WRITE_FLASH_BLOCKSIZE   .8
     #define ERASE_FLASH_BLOCKSIZE   .64
     #define END_FLASH               0x1000
     #define END_GPR                 0x200
#endif

#ifdef __18F4320
     #define DEVICEID                .41
     #define WRITE_FLASH_BLOCKSIZE   .8
     #define ERASE_FLASH_BLOCKSIZE   .64
     #define END_FLASH               0x2000
     #define END_GPR                 0x200
#endif

#ifdef __18F4321
     #define DEVICEID                .264
     #define WRITE_FLASH_BLOCKSIZE   .8
     #define ERASE_FLASH_BLOCKSIZE   .64
     #define END_FLASH               0x2000
     #define END_GPR                 0x200
#endif

#ifdef __18F4331
     #define DEVICEID                .69
     #define WRITE_FLASH_BLOCKSIZE   .8
     #define ERASE_FLASH_BLOCKSIZE   .64
     #define END_FLASH               0x2000
     #define END_GPR                 0x300
#endif

#ifdef __18F4410
     #define DEVICEID                .135
     #define WRITE_FLASH_BLOCKSIZE   .32
     #define ERASE_FLASH_BLOCKSIZE   .64
     #define END_FLASH               0x4000
     #define END_GPR                 0x300
#endif

#ifdef __18F4420
     #define DEVICEID                .134
     #define WRITE_FLASH_BLOCKSIZE   .32
     #define ERASE_FLASH_BLOCKSIZE   .64
     #define END_FLASH               0x4000
     #define END_GPR                 0x300
#endif

#ifdef __18F4423
     #define DEVICEID                .269
     #define WRITE_FLASH_BLOCKSIZE   .32
     #define ERASE_FLASH_BLOCKSIZE   .64
     #define END_FLASH               0x4000
     #define END_GPR                 0x300
#endif

#ifdef __18F4431
     #define DEVICEID                .68
     #define WRITE_FLASH_BLOCKSIZE   .8
     #define ERASE_FLASH_BLOCKSIZE   .64
     #define END_FLASH               0x4000
     #define END_GPR                 0x300
#endif

#ifdef __18F4439
     #define DEVICEID                .37
     #define WRITE_FLASH_BLOCKSIZE   .8
     #define ERASE_FLASH_BLOCKSIZE   .64
     #define END_FLASH               0x3000
     #define END_GPR                 0x280
#endif

#ifdef __18F4450
     #define DEVICEID                .288
     #define WRITE_FLASH_BLOCKSIZE   .16
     #define ERASE_FLASH_BLOCKSIZE   .64
     #define END_FLASH               0x4000
     #define END_GPR                 0x500
#endif

#ifdef __18F4455
     #define DEVICEID                .145
     #define WRITE_FLASH_BLOCKSIZE   .32
     #define ERASE_FLASH_BLOCKSIZE   .64
     #define END_FLASH               0x6000
     #define END_GPR                 0x800
#endif

#ifdef __18F4458
     #define DEVICEID                .337
     #define WRITE_FLASH_BLOCKSIZE   .32
     #define ERASE_FLASH_BLOCKSIZE   .64
     #define END_FLASH               0x6000
     #define END_GPR                 0x800
#endif

#ifdef __18F4480
     #define DEVICEID                .213
     #define WRITE_FLASH_BLOCKSIZE   .32
     #define ERASE_FLASH_BLOCKSIZE   .64
     #define END_FLASH               0x4000
     #define END_GPR                 0x300
#endif

#ifdef __18F4510
     #define DEVICEID                .133
     #define WRITE_FLASH_BLOCKSIZE   .32
     #define ERASE_FLASH_BLOCKSIZE   .64
     #define END_FLASH               0x8000
     #define END_GPR                 0x600
#endif

#ifdef __18F4515
     #define DEVICEID                .99
     #define WRITE_FLASH_BLOCKSIZE   .64
     #define ERASE_FLASH_BLOCKSIZE   .64
     #define END_FLASH               0xC000
     #define END_GPR                 0xF80
#endif

#ifdef __18F4520
     #define DEVICEID                .132
     #define WRITE_FLASH_BLOCKSIZE   .32
     #define ERASE_FLASH_BLOCKSIZE   .64
     #define END_FLASH               0x8000
     #define END_GPR                 0x600
#endif

#ifdef __18F4523
     #define DEVICEID                .265
     #define WRITE_FLASH_BLOCKSIZE   .32
     #define ERASE_FLASH_BLOCKSIZE   .64
     #define END_FLASH               0x8000
     #define END_GPR                 0x600
#endif

#ifdef __18F4525
     #define DEVICEID                .98
     #define WRITE_FLASH_BLOCKSIZE   .64
     #define ERASE_FLASH_BLOCKSIZE   .64
     #define END_FLASH               0xC000
     #define END_GPR                 0xF80
#endif

#ifdef __18F4539
     #define DEVICEID                .33
     #define WRITE_FLASH_BLOCKSIZE   .8
     #define ERASE_FLASH_BLOCKSIZE   .64
     #define END_FLASH               0x6000
     #define END_GPR                 0x580
#endif

#ifdef __18F4550
     #define DEVICEID                .144
     #define WRITE_FLASH_BLOCKSIZE   .32
     #define ERASE_FLASH_BLOCKSIZE   .64
     #define END_FLASH               0x8000
     #define END_GPR                 0x800
#endif

#ifdef __18F4553
     #define DEVICEID                .336
     #define WRITE_FLASH_BLOCKSIZE   .32
     #define ERASE_FLASH_BLOCKSIZE   .64
     #define END_FLASH               0x8000
     #define END_GPR                 0x800
#endif

#ifdef __18F4580
     #define DEVICEID                .212
     #define WRITE_FLASH_BLOCKSIZE   .32
     #define ERASE_FLASH_BLOCKSIZE   .64
     #define END_FLASH               0x8000
     #define END_GPR                 0x600
#endif

#ifdef __18F4585
     #define DEVICEID                .117
     #define WRITE_FLASH_BLOCKSIZE   .64
     #define ERASE_FLASH_BLOCKSIZE   .64
     #define END_FLASH               0xC000
     #define END_GPR                 0xD00
#endif

#ifdef __18F4610
     #define DEVICEID                .97
     #define WRITE_FLASH_BLOCKSIZE   .64
     #define ERASE_FLASH_BLOCKSIZE   .64
     #define END_FLASH               0x10000
     #define END_GPR                 0xF80
#endif

#ifdef __18F4620
     #define DEVICEID                .96
     #define WRITE_FLASH_BLOCKSIZE   .64
     #define ERASE_FLASH_BLOCKSIZE   .64
     #define END_FLASH               0x10000
     #define END_GPR                 0xF80
#endif

#ifdef __18F4680
     #define DEVICEID                .116
     #define WRITE_FLASH_BLOCKSIZE   .64
     #define ERASE_FLASH_BLOCKSIZE   .64
     #define END_FLASH               0x10000
     #define END_GPR                 0xD00
#endif

#ifdef __18F4682
     #define DEVICEID                .314
     #define WRITE_FLASH_BLOCKSIZE   .64
     #define ERASE_FLASH_BLOCKSIZE   .64
     #define END_FLASH               0x14000
     #define END_GPR                 0xD00
#endif

#ifdef __18F4685
     #define DEVICEID                .315
     #define WRITE_FLASH_BLOCKSIZE   .64
     #define ERASE_FLASH_BLOCKSIZE   .64
     #define END_FLASH               0x18000
     #define END_GPR                 0xD00
#endif

; PIC18F6310 does not support self-programming.
; PIC18F6390 does not support self-programming.
; PIC18F6393 does not support self-programming.
; PIC18F6410 does not support self-programming.
; PIC18F6490 does not support self-programming.
; PIC18F6493 does not support self-programming.
#ifdef __18F6520
     #define DEVICEID                .89
     #define WRITE_FLASH_BLOCKSIZE   .8
     #define ERASE_FLASH_BLOCKSIZE   .64
     #define END_FLASH               0x8000
     #define END_GPR                 0x800
#endif

#ifdef __18F6525
     #define DEVICEID                .87
     #define WRITE_FLASH_BLOCKSIZE   .8
     #define ERASE_FLASH_BLOCKSIZE   .64
     #define END_FLASH               0xC000
     #define END_GPR                 0xF00
#endif

#ifdef __18F6527
     #define DEVICEID                .154
     #define WRITE_FLASH_BLOCKSIZE   .64
     #define ERASE_FLASH_BLOCKSIZE   .64
     #define END_FLASH               0xC000
     #define END_GPR                 0xF60
#endif

#ifdef __18F6585
     #define DEVICEID                .83
     #define WRITE_FLASH_BLOCKSIZE   .8
     #define ERASE_FLASH_BLOCKSIZE   .64
     #define END_FLASH               0xC000
     #define END_GPR                 0xD00
#endif

#ifdef __18F6620
     #define DEVICEID                .51
     #define WRITE_FLASH_BLOCKSIZE   .8
     #define ERASE_FLASH_BLOCKSIZE   .64
     #define END_FLASH               0x10000
     #define END_GPR                 0xF00
#endif

#ifdef __18F6621
     #define DEVICEID                .85
     #define WRITE_FLASH_BLOCKSIZE   .8
     #define ERASE_FLASH_BLOCKSIZE   .64
     #define END_FLASH               0x10000
     #define END_GPR                 0xF00
#endif

#ifdef __18F6622
     #define DEVICEID                .156
     #define WRITE_FLASH_BLOCKSIZE   .64
     #define ERASE_FLASH_BLOCKSIZE   .64
     #define END_FLASH               0x10000
     #define END_GPR                 0xF60
#endif

#ifdef __18F6627
     #define DEVICEID                .158
     #define WRITE_FLASH_BLOCKSIZE   .64
     #define ERASE_FLASH_BLOCKSIZE   .64
     #define END_FLASH               0x18000
     #define END_GPR                 0xF60
#endif

#ifdef __18F6628
     #define DEVICEID                .590
     #define WRITE_FLASH_BLOCKSIZE   .64
     #define ERASE_FLASH_BLOCKSIZE   .64
     #define END_FLASH               0x18000
     #define END_GPR                 0xF60
#endif

#ifdef __18F6680
     #define DEVICEID                .81
     #define WRITE_FLASH_BLOCKSIZE   .8
     #define ERASE_FLASH_BLOCKSIZE   .64
     #define END_FLASH               0x10000
     #define END_GPR                 0xD00
#endif

#ifdef __18F6720
     #define DEVICEID                .49
     #define WRITE_FLASH_BLOCKSIZE   .8
     #define ERASE_FLASH_BLOCKSIZE   .64
     #define END_FLASH               0x20000
     #define END_GPR                 0xF00
#endif

#ifdef __18F6722
     #define DEVICEID                .160
     #define WRITE_FLASH_BLOCKSIZE   .64
     #define ERASE_FLASH_BLOCKSIZE   .64
     #define END_FLASH               0x20000
     #define END_GPR                 0xF60
#endif

#ifdef __18F6723
     #define DEVICEID                .592
     #define WRITE_FLASH_BLOCKSIZE   .64
     #define ERASE_FLASH_BLOCKSIZE   .64
     #define END_FLASH               0x20000
     #define END_GPR                 0xF60
#endif

; PIC18F8310 does not support self-programming.
; PIC18F8390 does not support self-programming.
; PIC18F8393 does not support self-programming.
; PIC18F8410 does not support self-programming.
; PIC18F8490 does not support self-programming.
; PIC18F8493 does not support self-programming.
#ifdef __18F8520
     #define DEVICEID                .88
     #define WRITE_FLASH_BLOCKSIZE   .8
     #define ERASE_FLASH_BLOCKSIZE   .64
     #define END_FLASH               0x8000
     #define END_GPR                 0x800
#endif

#ifdef __18F8525
     #define DEVICEID                .86
     #define WRITE_FLASH_BLOCKSIZE   .8
     #define ERASE_FLASH_BLOCKSIZE   .64
     #define END_FLASH               0xC000
     #define END_GPR                 0xF00
#endif

#ifdef __18F8527
     #define DEVICEID                .155
     #define WRITE_FLASH_BLOCKSIZE   .64
     #define ERASE_FLASH_BLOCKSIZE   .64
     #define END_FLASH               0xC000
     #define END_GPR                 0xF60
#endif

#ifdef __18F8585
     #define DEVICEID                .82
     #define WRITE_FLASH_BLOCKSIZE   .8
     #define ERASE_FLASH_BLOCKSIZE   .64
     #define END_FLASH               0xC000
     #define END_GPR                 0xD00
#endif

#ifdef __18F8620
     #define DEVICEID                .50
     #define WRITE_FLASH_BLOCKSIZE   .8
     #define ERASE_FLASH_BLOCKSIZE   .64
     #define END_FLASH               0x10000
     #define END_GPR                 0xF00
#endif

#ifdef __18F8621
     #define DEVICEID                .84
     #define WRITE_FLASH_BLOCKSIZE   .8
     #define ERASE_FLASH_BLOCKSIZE   .64
     #define END_FLASH               0x10000
     #define END_GPR                 0xF00
#endif

#ifdef __18F8622
     #define DEVICEID                .157
     #define WRITE_FLASH_BLOCKSIZE   .64
     #define ERASE_FLASH_BLOCKSIZE   .64
     #define END_FLASH               0x10000
     #define END_GPR                 0xF60
#endif

#ifdef __18F8627
     #define DEVICEID                .159
     #define WRITE_FLASH_BLOCKSIZE   .64
     #define ERASE_FLASH_BLOCKSIZE   .64
     #define END_FLASH               0x18000
     #define END_GPR                 0xF60
#endif

#ifdef __18F8628
     #define DEVICEID                .591
     #define WRITE_FLASH_BLOCKSIZE   .64
     #define ERASE_FLASH_BLOCKSIZE   .64
     #define END_FLASH               0x18000
     #define END_GPR                 0xF60
#endif

#ifdef __18F8680
     #define DEVICEID                .80
     #define WRITE_FLASH_BLOCKSIZE   .8
     #define ERASE_FLASH_BLOCKSIZE   .64
     #define END_FLASH               0x10000
     #define END_GPR                 0xD00
#endif

#ifdef __18F8720
     #define DEVICEID                .48
     #define WRITE_FLASH_BLOCKSIZE   .8
     #define ERASE_FLASH_BLOCKSIZE   .64
     #define END_FLASH               0x20000
     #define END_GPR                 0xF00
#endif

#ifdef __18F8722
     #define DEVICEID                .161
     #define WRITE_FLASH_BLOCKSIZE   .64
     #define ERASE_FLASH_BLOCKSIZE   .64
     #define END_FLASH               0x20000
     #define END_GPR                 0xF60
#endif

#ifdef __18F8723
     #define DEVICEID                .593
     #define WRITE_FLASH_BLOCKSIZE   .64
     #define ERASE_FLASH_BLOCKSIZE   .64
     #define END_FLASH               0x20000
     #define END_GPR                 0xF60
#endif

#ifdef __18LF13K22
     #define DEVICEID                .636
     #define WRITE_FLASH_BLOCKSIZE   .8
     #define ERASE_FLASH_BLOCKSIZE   .64
     #define END_FLASH               0x2000
     #define END_GPR                 0x100
#endif

#ifdef __18LF13K50
     #define DEVICEID                .568
     #define WRITE_FLASH_BLOCKSIZE   .8
     #define ERASE_FLASH_BLOCKSIZE   .64
     #define END_FLASH               0x2000
     #define END_GPR                 0x300
#endif

#ifdef __18LF14K22
     #define DEVICEID                .635
     #define WRITE_FLASH_BLOCKSIZE   .16
     #define ERASE_FLASH_BLOCKSIZE   .64
     #define END_FLASH               0x4000
     #define END_GPR                 0x200
#endif

#ifdef __18LF14K50
     #define DEVICEID                .569
     #define WRITE_FLASH_BLOCKSIZE   .16
     #define ERASE_FLASH_BLOCKSIZE   .64
     #define END_FLASH               0x4000
     #define END_GPR                 0x300
#endif

#ifdef __18LF23K22
     #define DEVICEID                .699
     #define WRITE_FLASH_BLOCKSIZE   .64
     #define ERASE_FLASH_BLOCKSIZE   .64
     #define END_FLASH               0x2000
     #define END_GPR                 0x200
#endif

#ifdef __18LF24J10
     #define CONFIG_AS_FLASH
     #define DEVICEID                .234
     #define WRITE_FLASH_BLOCKSIZE   .64
     #define ERASE_FLASH_BLOCKSIZE   .1024
     #define END_FLASH               0x4000
     #define END_GPR                 0x400
#endif

#ifdef __18LF24J11
     #define CONFIG_AS_FLASH
     #define DEVICEID                .626
     #define WRITE_FLASH_BLOCKSIZE   .64
     #define ERASE_FLASH_BLOCKSIZE   .1024
     #define END_FLASH               0x4000
     #define END_GPR                 0xEC0
#endif

#ifdef __18LF24J50
     #define CONFIG_AS_FLASH
     #define DEVICEID                .614
     #define WRITE_FLASH_BLOCKSIZE   .64
     #define ERASE_FLASH_BLOCKSIZE   .1024
     #define END_FLASH               0x4000
     #define END_GPR                 0xEC0
#endif

#ifdef __18LF24K22
     #define DEVICEID                .691
     #define WRITE_FLASH_BLOCKSIZE   .64
     #define ERASE_FLASH_BLOCKSIZE   .64
     #define END_FLASH               0x4000
     #define END_GPR                 0x300
#endif

#ifdef __18LF25J10
     #define CONFIG_AS_FLASH
     #define DEVICEID                .226
     #define WRITE_FLASH_BLOCKSIZE   .64
     #define ERASE_FLASH_BLOCKSIZE   .1024
     #define END_FLASH               0x8000
     #define END_GPR                 0x400
#endif

#ifdef __18LF25J11
     #define CONFIG_AS_FLASH
     #define DEVICEID                .627
     #define WRITE_FLASH_BLOCKSIZE   .64
     #define ERASE_FLASH_BLOCKSIZE   .1024
     #define END_FLASH               0x8000
     #define END_GPR                 0xEC0
#endif

#ifdef __18LF25J50
     #define CONFIG_AS_FLASH
     #define DEVICEID                .615
     #define WRITE_FLASH_BLOCKSIZE   .64
     #define ERASE_FLASH_BLOCKSIZE   .1024
     #define END_FLASH               0x8000
     #define END_GPR                 0xEC0
#endif

#ifdef __18LF25K22
     #define DEVICEID                .683
     #define WRITE_FLASH_BLOCKSIZE   .64
     #define ERASE_FLASH_BLOCKSIZE   .64
     #define END_FLASH               0x8000
     #define END_GPR                 0x600
#endif

#ifdef __18LF25K80
     #define DEVICEID                .787
     #define WRITE_FLASH_BLOCKSIZE   .64
     #define ERASE_FLASH_BLOCKSIZE   .64
     #define END_FLASH               0x8000
     #define END_GPR                 0xE41
#endif

#ifdef __18LF26J11
     #define CONFIG_AS_FLASH
     #define DEVICEID                .628
     #define WRITE_FLASH_BLOCKSIZE   .64
     #define ERASE_FLASH_BLOCKSIZE   .1024
     #define END_FLASH               0x10000
     #define END_GPR                 0xEC0
#endif

#ifdef __18LF26J13
     #define CONFIG_AS_FLASH
     #define DEVICEID                .729
     #define WRITE_FLASH_BLOCKSIZE   .64
     #define ERASE_FLASH_BLOCKSIZE   .1024
     #define END_FLASH               0x10000
     #define END_GPR                 0xEB0
#endif

#ifdef __18LF26J50
     #define CONFIG_AS_FLASH
     #define DEVICEID                .616
     #define WRITE_FLASH_BLOCKSIZE   .64
     #define ERASE_FLASH_BLOCKSIZE   .1024
     #define END_FLASH               0x10000
     #define END_GPR                 0xEC0
#endif

#ifdef __18LF26J53
     #define CONFIG_AS_FLASH
     #define DEVICEID                .721
     #define WRITE_FLASH_BLOCKSIZE   .64
     #define ERASE_FLASH_BLOCKSIZE   .1024
     #define END_FLASH               0x10000
     #define END_GPR                 0xEB0
#endif

#ifdef __18LF26K22
     #define DEVICEID                .675
     #define WRITE_FLASH_BLOCKSIZE   .64
     #define ERASE_FLASH_BLOCKSIZE   .64
     #define END_FLASH               0x10000
     #define END_GPR                 0xF38
#endif

#ifdef __18LF26K80
     #define DEVICEID                .784
     #define WRITE_FLASH_BLOCKSIZE   .64
     #define ERASE_FLASH_BLOCKSIZE   .64
     #define END_FLASH               0x10000
     #define END_GPR                 0xE41
#endif

#ifdef __18LF27J13
     #define CONFIG_AS_FLASH
     #define DEVICEID                .731
     #define WRITE_FLASH_BLOCKSIZE   .64
     #define ERASE_FLASH_BLOCKSIZE   .1024
     #define END_FLASH               0x20000
     #define END_GPR                 0xEB0
#endif

#ifdef __18LF27J53
     #define CONFIG_AS_FLASH
     #define DEVICEID                .723
     #define WRITE_FLASH_BLOCKSIZE   .64
     #define ERASE_FLASH_BLOCKSIZE   .1024
     #define END_FLASH               0x20000
     #define END_GPR                 0xEB0
#endif

#ifdef __18LF43K22
     #define DEVICEID                .697
     #define WRITE_FLASH_BLOCKSIZE   .64
     #define ERASE_FLASH_BLOCKSIZE   .64
     #define END_FLASH               0x2000
     #define END_GPR                 0x200
#endif

#ifdef __18LF44J10
     #define CONFIG_AS_FLASH
     #define DEVICEID                .235
     #define WRITE_FLASH_BLOCKSIZE   .64
     #define ERASE_FLASH_BLOCKSIZE   .1024
     #define END_FLASH               0x4000
     #define END_GPR                 0x400
#endif

#ifdef __18LF44J11
     #define CONFIG_AS_FLASH
     #define DEVICEID                .629
     #define WRITE_FLASH_BLOCKSIZE   .64
     #define ERASE_FLASH_BLOCKSIZE   .1024
     #define END_FLASH               0x4000
     #define END_GPR                 0xEC0
#endif

#ifdef __18LF44J50
     #define CONFIG_AS_FLASH
     #define DEVICEID                .617
     #define WRITE_FLASH_BLOCKSIZE   .64
     #define ERASE_FLASH_BLOCKSIZE   .1024
     #define END_FLASH               0x4000
     #define END_GPR                 0xEC0
#endif

#ifdef __18LF44K22
     #define DEVICEID                .689
     #define WRITE_FLASH_BLOCKSIZE   .64
     #define ERASE_FLASH_BLOCKSIZE   .64
     #define END_FLASH               0x4000
     #define END_GPR                 0x300
#endif

#ifdef __18LF45J10
     #define CONFIG_AS_FLASH
     #define DEVICEID                .227
     #define WRITE_FLASH_BLOCKSIZE   .64
     #define ERASE_FLASH_BLOCKSIZE   .1024
     #define END_FLASH               0x8000
     #define END_GPR                 0x400
#endif

#ifdef __18LF45J11
     #define CONFIG_AS_FLASH
     #define DEVICEID                .630
     #define WRITE_FLASH_BLOCKSIZE   .64
     #define ERASE_FLASH_BLOCKSIZE   .1024
     #define END_FLASH               0x8000
     #define END_GPR                 0xEC0
#endif

#ifdef __18LF45J50
     #define CONFIG_AS_FLASH
     #define DEVICEID                .618
     #define WRITE_FLASH_BLOCKSIZE   .64
     #define ERASE_FLASH_BLOCKSIZE   .1024
     #define END_FLASH               0x8000
     #define END_GPR                 0xEC0
#endif

#ifdef __18LF45K22
     #define DEVICEID                .681
     #define WRITE_FLASH_BLOCKSIZE   .64
     #define ERASE_FLASH_BLOCKSIZE   .64
     #define END_FLASH               0x8000
     #define END_GPR                 0x600
#endif

#ifdef __18LF45K80
     #define DEVICEID                .786
     #define WRITE_FLASH_BLOCKSIZE   .64
     #define ERASE_FLASH_BLOCKSIZE   .64
     #define END_FLASH               0x8000
     #define END_GPR                 0xE41
#endif

#ifdef __18LF46J11
     #define CONFIG_AS_FLASH
     #define DEVICEID                .631
     #define WRITE_FLASH_BLOCKSIZE   .64
     #define ERASE_FLASH_BLOCKSIZE   .1024
     #define END_FLASH               0x10000
     #define END_GPR                 0xEC0
#endif

#ifdef __18LF46J13
     #define CONFIG_AS_FLASH
     #define DEVICEID                .733
     #define WRITE_FLASH_BLOCKSIZE   .64
     #define ERASE_FLASH_BLOCKSIZE   .1024
     #define END_FLASH               0x10000
     #define END_GPR                 0xEB0
#endif

#ifdef __18LF46J50
     #define CONFIG_AS_FLASH
     #define DEVICEID                .619
     #define WRITE_FLASH_BLOCKSIZE   .64
     #define ERASE_FLASH_BLOCKSIZE   .1024
     #define END_FLASH               0x10000
     #define END_GPR                 0xEC0
#endif

#ifdef __18LF46J53
     #define CONFIG_AS_FLASH
     #define DEVICEID                .725
     #define WRITE_FLASH_BLOCKSIZE   .64
     #define ERASE_FLASH_BLOCKSIZE   .1024
     #define END_FLASH               0x10000
     #define END_GPR                 0xEB0
#endif

#ifdef __18LF46K22
     #define DEVICEID                .673
     #define WRITE_FLASH_BLOCKSIZE   .64
     #define ERASE_FLASH_BLOCKSIZE   .64
     #define END_FLASH               0x10000
     #define END_GPR                 0xF38
#endif

#ifdef __18LF46K80
     #define DEVICEID                .783
     #define WRITE_FLASH_BLOCKSIZE   .64
     #define ERASE_FLASH_BLOCKSIZE   .64
     #define END_FLASH               0x10000
     #define END_GPR                 0xE41
#endif

#ifdef __18LF47J13
     #define CONFIG_AS_FLASH
     #define DEVICEID                .735
     #define WRITE_FLASH_BLOCKSIZE   .64
     #define ERASE_FLASH_BLOCKSIZE   .1024
     #define END_FLASH               0x20000
     #define END_GPR                 0xEB0
#endif

#ifdef __18LF47J53
     #define CONFIG_AS_FLASH
     #define DEVICEID                .727
     #define WRITE_FLASH_BLOCKSIZE   .64
     #define ERASE_FLASH_BLOCKSIZE   .1024
     #define END_FLASH               0x20000
     #define END_GPR                 0xEB0
#endif

#ifdef __18LF65K80
     #define DEVICEID                .785
     #define WRITE_FLASH_BLOCKSIZE   .64
     #define ERASE_FLASH_BLOCKSIZE   .64
     #define END_FLASH               0x8000
     #define END_GPR                 0xE41
#endif

#ifdef __18LF66K80
     #define DEVICEID                .782
     #define WRITE_FLASH_BLOCKSIZE   .64
     #define ERASE_FLASH_BLOCKSIZE   .64
     #define END_FLASH               0x10000
     #define END_GPR                 0xE41
#endif
